## board/samsung/iTop4412/Kconfig
```kconfig
if TARGET_ITOP4412

config SYS_BOARD
	default "iTop4412"

config SYS_VENDOR
	default "samsung"

config SYS_CONFIG_NAME
	default "iTop4412"

endif
```

## configs/iTop4412_defconfig
```kconfig
CONFIG_SPL=y
CONFIG_ARM=y
CONFIG_ARCH_EXYNOS=y
CONFIG_TARGET_ITOP4412=y
CONFIG_OF_CONTROL=y
CONFIG_DEFAULT_DEVICE_TREE="exynos4412-iTop4412"
CONFIG_OF_EMBED=y
CONFIG_DEBUG_LL=y
CONFIG_DEBUG_UART_PHYS=0x13820000
CONFIG_DEBUG_UART_8250_FLOW_CONTROL=y

CONFIG_DM=y
CONFIG_DM_SERIAL=y
CONFIG_DM_GPIO=y
```
